## build-dir/conf/bblayers.conf
```bitbake
# POKY_BBLAYERS_CONF_VERSION is increased each time build/conf/bblayers.conf
# changes incompatibly
POKY_BBLAYERS_CONF_VERSION = "2"

BBPATH = "${TOPDIR}"
BBFILES ?= ""

BBLAYERS ?= " \
  /home/shifu/new/yocto_raspberrypi/poky/meta \
  /home/shifu/new/yocto_raspberrypi/poky/meta-poky \
  /home/shifu/new/yocto_raspberrypi/poky/meta-yocto-bsp \
  /home/shifu/new/yocto_raspberrypi/meta-raspberrypi \
  "
```
